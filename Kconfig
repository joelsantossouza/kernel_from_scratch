## Kconfig
```kconfig
# =============================================================================
# OPERATIONAL SYSTEM CONFIGURATION
# =============================================================================

mainmenu "Kernel From Scratch Configuration"

source "src/drivers/disk/Kconfig"

source "src/boot/Kconfig"

source "src/kernel/Kconfig"
```

## src/boot/Kconfig
```kconfig
# =============================================================================
# MBR CONFIGURATION
# =============================================================================

menu "MBR Configuration"

# --------------------------------------
# Partition0
# --------------------------------------
	config MBR_PART0_BOOT_ATTR
		hex
		default 0x80 if DISK_PART0_BOOTABLE
		default 0x0

	config MBR_PART0_TYPECODE
		hex
		default 0x0E if DISK_PART0_FS_FAT16_LBA
		default 0x0
		
# --------------------------------------
# Partition1
# --------------------------------------
	config MBR_PART1_BOOT_ATTR
		hex
		default 0x80 if DISK_PART1_BOOTABLE
		default 0x0

	config MBR_PART1_TYPECODE
		hex
		default 0x0E if DISK_PART1_FS_FAT16_LBA
		default 0x0
		
# --------------------------------------
# Partition2
# --------------------------------------
	config MBR_PART2_BOOT_ATTR
		hex
		default 0x80 if DISK_PART2_BOOTABLE
		default 0x0

	config MBR_PART2_TYPECODE
		hex
		default 0x0E if DISK_PART2_FS_FAT16_LBA
		default 0x0
		
# --------------------------------------
# Partition3
# --------------------------------------
	config MBR_PART3_BOOT_ATTR
		hex
		default 0x80 if DISK_PART3_BOOTABLE
		default 0x0

	config MBR_PART3_TYPECODE
		hex
		default 0x0E if DISK_PART3_FS_FAT16_LBA
		default 0x0

endmenu

# =============================================================================
# BOOTLOADER CONFIGURATION
# =============================================================================

menu "Bootloader Configuration"

	config BOOT_STAGE2_ADDR
		hex "Address to Load Bootloader"
		range 0x7E00 0x7FFFF
		default 0x7E00

	config BOOT_STAGE2_SECTORS
		int "Bootloader Total Sectors"
		range 1 127
		default 20

	config BOOT_STAGE2_SECTOR
		int "Bootloader Disk LBA"
		range 2 63
		default 2

	config BOOT_STAGE2_CYLINDER
		int "Bootloader Disk CHS Cylinder"
		range 0 1023
		default 0

	config BOOT_STAGE2_HEAD
		int "Bootloader Disk CHS Head"
		range 0 255
		default 0

endmenu
```

## src/drivers/disk/Kconfig
```kconfig
# =============================================================================
# DISK CONFIGURATION
# =============================================================================

menu "Disk Configuration"

	comment "Physical Disk Layer"

	config DISK_SECTORS
		hex "Disk Total Sectors"
		range 0x10000 0x20000
		default 0x10000

	comment "Virtual Disk Layer (VDL)"

	config VDL_CACHE_ENTRY_COUNT
		int "Number of Cache Entries"
		range 1 16
		default 8

	config VDL_CACHE_ENTRY_SECTORS
		int "Sectors per Cache Entry"
		range 1 4
		default 2

	comment "ATA Controller"

	config ATA_TIMEOUT_CYCLES
		int "Max cycles before ATA timeout"
		range 100 1000
		default 1000

endmenu

# =============================================================================
# PARTITION CONFIGURATION
# =============================================================================

menu "Partition Configuration"

# --------------------------------------
# Partition0
# --------------------------------------
	comment "Partition0"

	config DISK_PART0_START
		hex
		default 0x800

	config DISK_PART0_END
		hex "Partition0 LBA end on disk"
		range DISK_PART0_START DISK_SECTORS
		default 0x4600

	config DISK_PART0_BOOTABLE
		bool "Partition0 Bootable"
		default n

	choice
		prompt "Partition0 File System:"
	config DISK_PART0_FS_FAT16_LBA
		bool "FAT16 LBA"
	endchoice

	config DISK_PART0_FS_FAMILY
		string
		default "fat" if DISK_PART0_FS_FAT16_LBA

	config DISK_PART0_FS_VERSION
		int
		default 16 if DISK_PART0_FS_FAT16_LBA

# --------------------------------------
# Partition1
# --------------------------------------
	comment "Partition1"

	config DISK_PART1_START
		hex
		default DISK_PART0_END

	config DISK_PART1_END
		hex "Partition1 LBA end on disk"
		range DISK_PART1_START DISK_SECTORS
		default 0x8400

	config DISK_PART1_BOOTABLE
		bool "Partition1 Bootable"
		default n

	choice
		prompt "Partition1 File System:"
	config DISK_PART1_FS_FAT16_LBA
		bool "FAT16 LBA"
	endchoice

	config DISK_PART1_FS_FAMILY
		string
		default "fat" if DISK_PART1_FS_FAT16_LBA

	config DISK_PART1_FS_VERSION
		int
		default 16 if DISK_PART1_FS_FAT16_LBA

# --------------------------------------
# Partition2
# --------------------------------------
	comment "Partition2"

	config DISK_PART2_START
		hex
		default DISK_PART1_END

	config DISK_PART2_END
		hex "Partition2 LBA end on disk"
		range DISK_PART2_START DISK_SECTORS
		default 0xC200

	config DISK_PART2_BOOTABLE
		bool "Partition2 Bootable"
		default n

	choice
		prompt "Partition2 File System:"
	config DISK_PART2_FS_FAT16_LBA
		bool "FAT16 LBA"
	endchoice

	config DISK_PART2_FS_FAMILY
		string
		default "fat" if DISK_PART2_FS_FAT16_LBA

	config DISK_PART2_FS_VERSION
		int
		default 16 if DISK_PART2_FS_FAT16_LBA

# --------------------------------------
# Partition3
# --------------------------------------
	comment "Partition3"

	config DISK_PART3_START
		hex
		default DISK_PART2_END

	config DISK_PART3_END
		hex
		default DISK_SECTORS

	config DISK_PART3_BOOTABLE
		bool "Partition3 Bootable"
		default n

	choice
		prompt "Partition3 File System:"
	config DISK_PART3_FS_FAT16_LBA
		bool "FAT16 LBA"
	endchoice

	config DISK_PART3_FS_FAMILY
		string
		default "fat" if DISK_PART3_FS_FAT16_LBA

	config DISK_PART3_FS_VERSION
		int
		default 16 if DISK_PART3_FS_FAT16_LBA

endmenu
```

## src/kernel/Kconfig
```kconfig
# =============================================================================
# KERNEL CONFIGURATION
# =============================================================================

menu "Kernel Configuration"

	config KERNEL_ADDR
		hex "Address to load Kernel"
		range 0x100000 0x200000
		default 0x100000

endmenu
```
